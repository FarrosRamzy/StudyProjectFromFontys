# file: 1_LED_button_b.ioc
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Mcu.Family=STM32F3
Mcu.Name=STM32F303R(D-E)Tx
Mcu.Package=LQFP64
NVIC.PriorityGroup=NVIC_PRIORITYGROUP_4
ProjectManager.HeapSize=0x200
ProjectManager.StackSize=0x400
ProjectManager.TargetToolchain=STM32CubeIDE
RCC.AHBFreq_Value=8000000
RCC.APB1Freq_Value=8000000
RCC.APB2Freq_Value=8000000
RCC.CortexFreq_Value=8000000
RCC.HSE_VALUE=8000000
RCC.HSI_VALUE=8000000
RCC.LSE_VALUE=32768
RCC.SYSCLKFreq_VALUE=8000000
RCC.USBFreq_Value=16000000
board=custom

// file: Core/Src/main.c
/* USER CODE BEGIN Header */
/**
 ******************************************************************************
 * @file           : main.c
 * @brief          : Main program body
 *
 * Written by	   : Farros Ramzy (3767353)
 * Assignment	   : 1 b Embedded System (LED_push_button)
 * Date			   : 21/02/2024
 ******************************************************************************
 * @attention
 *
 * Copyright (c) 2024 STMicroelectronics.
 * All rights reserved.
 *
 * This software is licensed under terms that can be found in the LICENSE file
 * in the root directory of this software component.
 * If no LICENSE file comes with this software, it is provided AS-IS.
 *
 ******************************************************************************
 */

/* USER CODE END Header */
#include "main.h"

void SystemClock_Config(void);

int main(void) {
	/* USER CODE BEGIN 1 */
	gpio_port_en();
	gpio_a_init();
	gpio_b_init();
	/* USER CODE END 1 */

	/* MCU Configuration--------------------------------------------------------*/

	/* Reset of all peripherals, Initializes the Flash interface and the Systick. */
	HAL_Init();

	/* Configure the system clock */
	SystemClock_Config();

	/* Initialize all configured peripherals */
	/* USER CODE BEGIN 2 */
	//sets the button 1 switch state.
	uint8_t btn_1_pressed = 0;

	//sets the sweep LED rows' configuration.
	uint8_t led_sweep_type = 0;
	uint8_t sweep_a_to_left = 1;
	uint8_t sweep_b_to_left = 1;

	uint8_t sweep_a_counter = 0;
	uint8_t sweep_b_counter = 0;
	uint8_t sweep_b_adder = 0;
	uint8_t sweep_b_reverse = 0;

	//sets all LEDs to off.
	set_led(GPIOB, LOW, GPIO_PIN_1);
	all_sweep_off();
	/* USER CODE END 2 */

	/* Infinite loop */
	/* USER CODE BEGIN WHILE */
	while (1) {
		//Button 1 de-bouncing to toggle the single LED.
		if (button_press(GPIOA, GPIO_PIN_8) == HIGH) {
			HAL_Delay(100);
			if (button_press(GPIOA, GPIO_PIN_8) == HIGH) {
				toggle_output(GPIOB, &btn_1_pressed, GPIO_PIN_1);
			}
			while (button_press(GPIOA, GPIO_PIN_8) == HIGH) {
				//wait until button is released.
			}
		}

		//Button 2 de-bouncing to switch the sweep mode of the LEDs' row.
		if (button_press(GPIOA, GPIO_PIN_9) == HIGH) {
			HAL_Delay(100);
			if (button_press(GPIOA, GPIO_PIN_9) == HIGH) {
				switch_sweep_state(&led_sweep_type);
			}
			while (button_press(GPIOA, GPIO_PIN_9) == HIGH) {
				//wait 'till release.
			}
		}

		//Run sweeps per state.
		if (led_sweep_type == 0) {
			all_sweep_off();
		}
		else if (led_sweep_type == 1) {
			sweep_a(&sweep_a_counter, &sweep_a_to_left);
		} else if (led_sweep_type == 2) {
			sweep_b(&sweep_b_counter, &sweep_b_adder, &sweep_b_reverse,
					&sweep_b_to_left);
		}
		/* USER CODE END WHILE */

	}
}

void SystemClock_Config(void) {
	RCC_OscInitTypeDef RCC_OscInitStruct = { 0 };
	RCC_ClkInitTypeDef RCC_ClkInitStruct = { 0 };

	/** Initializes the RCC Oscillators according to the specified parameters
	 * in the RCC_OscInitTypeDef structure.
	 */
	RCC_OscInitStruct.OscillatorType = RCC_OSCILLATORTYPE_HSI;
	RCC_OscInitStruct.HSIState = RCC_HSI_ON;
	RCC_OscInitStruct.HSICalibrationValue = RCC_HSICALIBRATION_DEFAULT;
	RCC_OscInitStruct.PLL.PLLState = RCC_PLL_NONE;
	if (HAL_RCC_OscConfig(&RCC_OscInitStruct) != HAL_OK) {
		Error_Handler();
	}

	/** Initializes the CPU, AHB and APB buses clocks
	 */
	RCC_ClkInitStruct.ClockType = RCC_CLOCKTYPE_HCLK | RCC_CLOCKTYPE_SYSCLK
			| RCC_CLOCKTYPE_PCLK1 | RCC_CLOCKTYPE_PCLK2;
	RCC_ClkInitStruct.SYSCLKSource = RCC_SYSCLKSOURCE_HSI;
	RCC_ClkInitStruct.AHBCLKDivider = RCC_SYSCLK_DIV1;
	RCC_ClkInitStruct.APB1CLKDivider = RCC_HCLK_DIV1;
	RCC_ClkInitStruct.APB2CLKDivider = RCC_HCLK_DIV1;

	if (HAL_RCC_ClockConfig(&RCC_ClkInitStruct, FLASH_LATENCY_0) != HAL_OK) {
		Error_Handler();
	}
}

void Error_Handler(void) {
	__disable_irq();
	while (1) {
	}
}
