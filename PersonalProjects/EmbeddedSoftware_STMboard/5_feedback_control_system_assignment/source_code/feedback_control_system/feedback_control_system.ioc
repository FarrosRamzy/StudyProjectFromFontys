# file: feedback_control_system.ioc
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Mcu.Family=STM32F3
Mcu.Name=STM32F303R(D-E)Tx
Mcu.Package=LQFP64
NVIC.PriorityGroup=NVIC_PRIORITYGROUP_4
ProjectManager.HeapSize=0x200
ProjectManager.StackSize=0x400
ProjectManager.TargetToolchain=STM32CubeIDE
RCC.AHBFreq_Value=8000000
RCC.APB1Freq_Value=8000000
RCC.APB2Freq_Value=8000000
RCC.CortexFreq_Value=8000000
RCC.HSE_VALUE=8000000
RCC.HSI_VALUE=8000000
RCC.LSE_VALUE=32768
RCC.SYSCLKFreq_VALUE=8000000
RCC.USBFreq_Value=16000000
board=custom

// file: Core/Src/main.c
/* USER CODE BEGIN Header */
/**
 ******************************************************************************
 * @file           : main.c
 * @brief          : Main program body
 * @author			: Farros Ramzy
 ******************************************************************************
 * @attention
 *
 * Copyright (c) 2024 STMicroelectronics.
 * All rights reserved.
 *
 * This software is licensed under terms that can be found in the LICENSE file
 * in the root directory of this software component.
 * If no LICENSE file comes with this software, it is provided AS-IS.
 *
 ******************************************************************************
 */
/* USER CODE END Header */
#include "main.h"

/* USER CODE BEGIN PD */
#define MAX_OUTPUT_POWER 200
#define OBSTACLE_POINT 20

/* USER CODE END PD */

/* USER CODE BEGIN PV */
const double kI = 0.549378309652703;
const double kP = 0.156755704961953;
const double kD = 0.0904541280843227;

double my_pid_values;
double measured_points;
/* USER CODE END PV */

void SystemClock_Config(void);
/* USER CODE BEGIN PFP */
double my_pid(double, double);
double measure_distance(void);
/* USER CODE END PFP */

int main(void) {

	/* MCU Configuration--------------------------------------------------------*/

	/* Reset of all peripherals, Initializes the Flash interface and the Systick. */
	HAL_Init();

	/* Configure the system clock */
	SystemClock_Config();

	/* Initialize all configured peripherals */

	/* Infinite loop */
	while (1) {

		/* USER CODE BEGIN 3 */
		measured_points = measure_distance();
		my_pid_values = my_pid(OBSTACLE_POINT, measured_points);
	}
	/* USER CODE END 3 */
}

void SystemClock_Config(void) {
	RCC_OscInitTypeDef RCC_OscInitStruct = { 0 };
	RCC_ClkInitTypeDef RCC_ClkInitStruct = { 0 };

	/** Initializes the RCC Oscillators according to the specified parameters
	 * in the RCC_OscInitTypeDef structure.
	 */
	RCC_OscInitStruct.OscillatorType = RCC_OSCILLATORTYPE_HSI;
	RCC_OscInitStruct.HSIState = RCC_HSI_ON;
	RCC_OscInitStruct.HSICalibrationValue = RCC_HSICALIBRATION_DEFAULT;
	RCC_OscInitStruct.PLL.PLLState = RCC_PLL_NONE;
	if (HAL_RCC_OscConfig(&RCC_OscInitStruct) != HAL_OK) {
		Error_Handler();
	}

	/** Initializes the CPU, AHB and APB buses clocks
	 */
	RCC_ClkInitStruct.ClockType = RCC_CLOCKTYPE_HCLK | RCC_CLOCKTYPE_SYSCLK
			| RCC_CLOCKTYPE_PCLK1 | RCC_CLOCKTYPE_PCLK2;
	RCC_ClkInitStruct.SYSCLKSource = RCC_SYSCLKSOURCE_HSI;
	RCC_ClkInitStruct.AHBCLKDivider = RCC_SYSCLK_DIV1;
	RCC_ClkInitStruct.APB1CLKDivider = RCC_HCLK_DIV1;
	RCC_ClkInitStruct.APB2CLKDivider = RCC_HCLK_DIV1;

	if (HAL_RCC_ClockConfig(&RCC_ClkInitStruct, FLASH_LATENCY_0) != HAL_OK) {
		Error_Handler();
	}
}

/* USER CODE BEGIN 4 */
double my_pid(double obstacle_distance, double measured_distance) {
	static double integral_val = 0;
	static double prev_error = 0;

//1. Calculate error as the difference between the obstacle distance and the measured
//distance.
	double error_val = measured_distance - obstacle_distance;

	if (error_val == 0 || error_val > obstacle_distance) {
		integral_val = 0;
	}
//2.a. calculate Proportional from error value and the kP
	double proportional = error_val * kP;

//2.b. Integral from error value and the kI
	integral_val += error_val;
	integral_val = integral_val * kI;

//2.c. Derivative from error value's difference, then the kD
	double derivative = error_val - prev_error;
	derivative = derivative * kD;

	prev_error = error_val;

//3. Total PID output
	double pid_output = proportional + derivative + integral_val;

//4. Set PID result to prevent a big oscalation.
	if (pid_output > MAX_OUTPUT_POWER) {
		pid_output = MAX_OUTPUT_POWER;
	}

	return pid_output;
}

double measure_distance() {
	return 0;
}

/* USER CODE END 4 */

void Error_Handler(void) {
	__disable_irq();
	while (1) {
	}
}
